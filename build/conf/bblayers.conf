## build/conf/bblayers.conf
```bitbake
# POKY_BBLAYERS_CONF_VERSION is increased each time build/conf/bblayers.conf
# changes incompatibly
POKY_BBLAYERS_CONF_VERSION = "2"

BBPATH = "${TOPDIR}"
BBFILES ?= ""

BBLAYERS ?= " \
  /home/nick/4/poky/meta \
  /home/nick/4/poky/meta-poky \
  /home/nick/4/poky/meta-yocto-bsp \
  /home/nick/4/meta-pynq \
  /home/nick/4/meta-xilinx/meta-xilinx-bsp \
  /home/nick/4/meta-xilinx/meta-xilinx-contrib \
  /home/nick/4/meta-group04 \
  /home/nick/4/meta-tie50307 \
  "
```

## meta-group04/conf/layer.conf
```bitbake
# We have a conf and classes directory, add to BBPATH
BBPATH .= ":${LAYERDIR}"

# We have recipes-* directories, add to BBFILES
BBFILES += "${LAYERDIR}/recipes-*/*/*.bb \
            ${LAYERDIR}/recipes-*/*/*.bbappend"

BBFILE_COLLECTIONS += "group04"
BBFILE_PATTERN_group04 = "^${LAYERDIR}/"
BBFILE_PRIORITY_group04 = "6"

LAYERDEPENDS_group04= "core"
```
